## main/Kconfig.projbuild
```kconfig
menu "Configuração do projeto"

config WIFI_SSID
    string "WiFi SSID"
    default "meu_ssid"
    help
        SSID (network name) for the example to connect to.

config WIFI_PASSWORD
    string "WiFi Password"
    default "meu_password"
    help
        WiFi password (WPA or WPA2) for the example to use.

choice IP_MODE
    prompt "IP Version"
    help
       Example can use either IPV4 or IPV6.

config IP_MODE_IPV4
    bool "IPV4"

config IP_MODE_IPV6
   bool "IPV6"
   select CONNECT_IPV6

endchoice

config SERVER_PORT
    int "Port"
    range 0 65535
    default 3333
    help
        Local port the example server will listen on.

endmenu
```
